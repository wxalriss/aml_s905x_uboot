// SPDX-License-Identifier: (GPL-2.0+ OR MIT)
/*
 * Copyright (C) 2018 BayLibre, SAS
 * Author: Neil Armstrong <narmstrong@baylibre.com>
 */

#include "sun8i-h3-libretech-all-h3-cc.dts"

/ {
	model = "Libre Computer Board ALL-H3-CC H5";
	compatible = "libretech,all-h3-cc-h5", "allwinner,sun50i-h5";
};
